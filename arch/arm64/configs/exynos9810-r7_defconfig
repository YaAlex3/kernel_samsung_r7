## arch/arm64/configs/exynos9810-r7_defconfig
```kconfig
CONFIG_LOCALVERSION="-lateM"
# CONFIG_LOCALVERSION_AUTO is not set
# CONFIG_FHANDLE is not set
CONFIG_TOOLS_SUPPORT_RELR=y
CONFIG_RELR=y
CONFIG_AUDIT=y
CONFIG_NO_HZ=y
CONFIG_HIGH_RES_TIMERS=y
CONFIG_TASKSTATS=y
CONFIG_TASK_DELAY_ACCT=y
CONFIG_TASK_XACCT=y
CONFIG_TASK_IO_ACCOUNTING=y
CONFIG_RCU_EXPERT=y
CONFIG_RCU_FAST_NO_HZ=y
CONFIG_RCU_BOOST=y
CONFIG_IKCONFIG=y
CONFIG_IKCONFIG_PROC=y
CONFIG_LOG_BUF_SHIFT=19
CONFIG_CGROUPS=y
CONFIG_CGROUP_DEBUG=y
CONFIG_CGROUP_FREEZER=y
CONFIG_CPUSETS=y
CONFIG_CGROUP_CPUACCT=y
CONFIG_CGROUP_SCHEDTUNE=y
CONFIG_MEMCG=y
CONFIG_MEMCG_SWAP=y
CONFIG_CGROUP_SCHED=y
CONFIG_CFS_BANDWIDTH=y
CONFIG_RT_GROUP_SCHED=y
CONFIG_CGROUP_BPF=y
CONFIG_NAMESPACES=y
CONFIG_SCHED_TUNE=y
CONFIG_SCHED_EHMP=y
CONFIG_DEFAULT_USE_ENERGY_AWARE=y
CONFIG_SCHED_USE_FLUID_RT=y
CONFIG_BLK_DEV_INITRD=y
CONFIG_LD_DEAD_CODE_DATA_ELIMINATION=y
CONFIG_BPF_SYSCALL=y
CONFIG_EMBEDDED=y
# CONFIG_COMPAT_BRK is not set
CONFIG_DEFERRED_INITCALLS=y
CONFIG_PROFILING=y
CONFIG_KPROBES=y
CONFIG_JUMP_LABEL=y
CONFIG_CC_STACKPROTECTOR_STRONG=y
CONFIG_LD_LLD=y
CONFIG_LTO_CLANG=y
CONFIG_LLVM_POLLY=y
CONFIG_MODULES=y
CONFIG_MODULE_UNLOAD=y
CONFIG_MODVERSIONS=y
# CONFIG_BLK_DEV_BSG is not set
CONFIG_PARTITION_ADVANCED=y
# CONFIG_IOSCHED_DEADLINE is not set
CONFIG_SOC_EXYNOS9810=y
CONFIG_SOC_EXYNOS9810_EVT1=y
CONFIG_ARCH_EXYNOS9=y
CONFIG_PCI=y
CONFIG_PCI_EXYNOS=y
CONFIG_EXYNOS_PCIE_IOMMU=y
CONFIG_ARM64_ERRATUM_843419=y
CONFIG_SCHED_MC=y
CONFIG_NR_CPUS=8
CONFIG_PREEMPT=y
CONFIG_KSM=y
CONFIG_ZSMALLOC=y
CONFIG_PGTABLE_MAPPING=y
# CONFIG_SWAP_ENABLE_READAHEAD is not set
CONFIG_RBIN=y
CONFIG_PAGE_BOOST=y
CONFIG_ARMV8_DEPRECATED=y
CONFIG_SWP_EMULATION=y
CONFIG_CP15_BARRIER_EMULATION=y
CONFIG_SETEND_EMULATION=y
CONFIG_ARM64_SW_TTBR0_PAN=y
# CONFIG_ARM64_HW_AFDBM is not set
# CONFIG_ARM64_PAN is not set
# CONFIG_ARM64_VHE is not set
# CONFIG_ARM64_UAO is not set
CONFIG_RANDOMIZE_BASE=y
CONFIG_CMDLINE="androidboot.selinux=permissive"
CONFIG_CMDLINE_EXTEND=y
# CONFIG_EFI is not set
# CONFIG_CORE_DUMP_DEFAULT_ELF_HEADERS is not set
CONFIG_COMPAT=y
CONFIG_PM_WAKELOCKS=y
CONFIG_PM_WAKELOCKS_LIMIT=0
# CONFIG_PM_WAKELOCKS_GC is not set
CONFIG_DPM_WATCHDOG=y
CONFIG_DPM_WATCHDOG_TIMEOUT=10
CONFIG_CPU_IDLE=y
CONFIG_ARM64_EXYNOS_CPUIDLE=y
CONFIG_CPU_FREQ=y
CONFIG_CPU_FREQ_STAT=y
CONFIG_CPU_FREQ_DEFAULT_GOV_SCHEDUTIL=y
CONFIG_ARM_EXYNOS_ACME=y
CONFIG_ARM_EXYNOS_UFC=y
CONFIG_NET=y
CONFIG_PACKET=y
CONFIG_UNIX=y
CONFIG_XFRM_USER=y
CONFIG_XFRM_INTERFACE=y
CONFIG_XFRM_STATISTICS=y
CONFIG_NET_KEY=y
CONFIG_INET=y
CONFIG_IP_MULTICAST=y
CONFIG_IP_ADVANCED_ROUTER=y
CONFIG_IP_MULTIPLE_TABLES=y
CONFIG_IP_PNP=y
CONFIG_IP_PNP_DHCP=y
CONFIG_IP_PNP_BOOTP=y
CONFIG_IP_PNP_RARP=y
CONFIG_NET_IPGRE_DEMUX=y
CONFIG_NET_IPVTI=y
CONFIG_INET_ESP=y
# CONFIG_INET_XFRM_MODE_BEET is not set
CONFIG_INET_UDP_DIAG=y
CONFIG_INET_DIAG_DESTROY=y
CONFIG_TCP_CONG_ADVANCED=y
CONFIG_TCP_CONG_BIC=y
CONFIG_TCP_CONG_WESTWOOD=y
CONFIG_TCP_CONG_HTCP=y
CONFIG_DEFAULT_BIC=y
CONFIG_IPV6_ROUTER_PREF=y
CONFIG_IPV6_ROUTE_INFO=y
CONFIG_IPV6_OPTIMISTIC_DAD=y
CONFIG_INET6_AH=y
CONFIG_INET6_ESP=y
CONFIG_INET6_IPCOMP=y
CONFIG_IPV6_MIP6=y
CONFIG_IPV6_VTI=y
CONFIG_IPV6_MULTIPLE_TABLES=y
CONFIG_NETFILTER=y
CONFIG_NF_CONNTRACK=y
CONFIG_NF_CONNTRACK_SECMARK=y
CONFIG_NF_CONNTRACK_EVENTS=y
CONFIG_NF_CT_PROTO_DCCP=y
CONFIG_NF_CT_PROTO_SCTP=y
CONFIG_NF_CT_PROTO_UDPLITE=y
CONFIG_NF_CONNTRACK_AMANDA=y
CONFIG_NF_CONNTRACK_FTP=y
CONFIG_NF_CONNTRACK_H323=y
CONFIG_NF_CONNTRACK_IRC=y
CONFIG_NF_CONNTRACK_NETBIOS_NS=y
CONFIG_NF_CONNTRACK_PPTP=y
CONFIG_NF_CONNTRACK_SANE=y
CONFIG_NF_CONNTRACK_TFTP=y
CONFIG_NF_CT_NETLINK=y
CONFIG_NETFILTER_XT_TARGET_CLASSIFY=y
CONFIG_NETFILTER_XT_TARGET_CONNMARK=y
CONFIG_NETFILTER_XT_TARGET_CONNSECMARK=y
CONFIG_NETFILTER_XT_TARGET_CT=y
CONFIG_NETFILTER_XT_TARGET_IDLETIMER=y
CONFIG_NETFILTER_XT_TARGET_LOG=y
CONFIG_NETFILTER_XT_TARGET_MARK=y
CONFIG_NETFILTER_XT_TARGET_NFLOG=y
CONFIG_NETFILTER_XT_TARGET_NFQUEUE=y
CONFIG_NETFILTER_XT_TARGET_TPROXY=y
CONFIG_NETFILTER_XT_TARGET_TRACE=y
CONFIG_NETFILTER_XT_TARGET_SECMARK=y
CONFIG_NETFILTER_XT_TARGET_TCPMSS=y
CONFIG_NETFILTER_XT_MATCH_BPF=y
CONFIG_NETFILTER_XT_MATCH_COMMENT=y
CONFIG_NETFILTER_XT_MATCH_CONNBYTES=y
CONFIG_NETFILTER_XT_MATCH_CONNLABEL=y
CONFIG_NETFILTER_XT_MATCH_CONNLIMIT=y
CONFIG_NETFILTER_XT_MATCH_CONNMARK=y
CONFIG_NETFILTER_XT_MATCH_CONNTRACK=y
CONFIG_NETFILTER_XT_MATCH_HASHLIMIT=y
CONFIG_NETFILTER_XT_MATCH_HELPER=y
CONFIG_NETFILTER_XT_MATCH_IPRANGE=y
CONFIG_NETFILTER_XT_MATCH_LENGTH=y
CONFIG_NETFILTER_XT_MATCH_LIMIT=y
CONFIG_NETFILTER_XT_MATCH_MAC=y
CONFIG_NETFILTER_XT_MATCH_MARK=y
CONFIG_NETFILTER_XT_MATCH_OWNER=y
CONFIG_NETFILTER_XT_MATCH_POLICY=y
CONFIG_NETFILTER_XT_MATCH_PKTTYPE=y
CONFIG_NETFILTER_XT_MATCH_QUOTA=y
CONFIG_NETFILTER_XT_MATCH_QUOTA2=y
CONFIG_NETFILTER_XT_MATCH_QUOTA2_LOG=y
CONFIG_NETFILTER_XT_MATCH_SCTP=y
CONFIG_NETFILTER_XT_MATCH_SOCKET=y
CONFIG_NETFILTER_XT_MATCH_STATE=y
CONFIG_NETFILTER_XT_MATCH_STATISTIC=y
CONFIG_NETFILTER_XT_MATCH_STRING=y
CONFIG_NETFILTER_XT_MATCH_TIME=y
CONFIG_NETFILTER_XT_MATCH_U32=y
CONFIG_NF_HISTORY=y
CONFIG_NF_CONNTRACK_IPV4=y
CONFIG_IP_NF_IPTABLES=y
CONFIG_IP_NF_MATCH_AH=y
CONFIG_IP_NF_MATCH_ECN=y
CONFIG_IP_NF_MATCH_RPFILTER=y
CONFIG_IP_NF_MATCH_TTL=y
CONFIG_IP_NF_FILTER=y
CONFIG_IP_NF_TARGET_REJECT=y
CONFIG_IP_NF_NAT=y
CONFIG_IP_NF_TARGET_MASQUERADE=y
CONFIG_IP_NF_TARGET_NETMAP=y
CONFIG_IP_NF_TARGET_REDIRECT=y
CONFIG_IP_NF_MANGLE=y
CONFIG_IP_NF_RAW=y
CONFIG_IP_NF_SECURITY=y
CONFIG_IP_NF_ARPTABLES=y
CONFIG_IP_NF_ARPFILTER=y
CONFIG_IP_NF_ARP_MANGLE=y
CONFIG_NF_CONNTRACK_IPV6=y
CONFIG_IP6_NF_IPTABLES=y
CONFIG_IP6_NF_MATCH_RPFILTER=y
CONFIG_IP6_NF_FILTER=y
CONFIG_IP6_NF_TARGET_REJECT=y
CONFIG_IP6_NF_MANGLE=y
CONFIG_IP6_NF_RAW=y
CONFIG_IP6_NF_NAT=y
CONFIG_L2TP=y
CONFIG_NET_SCHED=y
CONFIG_NET_SCH_HTB=y
CONFIG_NET_SCH_PRIO=y
CONFIG_NET_SCH_NETEM=y
CONFIG_NET_SCH_INGRESS=y
CONFIG_NET_CLS_BASIC=y
CONFIG_NET_CLS_U32=y
CONFIG_NET_CLS_BPF=y
CONFIG_NET_EMATCH=y
CONFIG_NET_EMATCH_U32=y
CONFIG_NET_CLS_ACT=y
CONFIG_NET_ACT_POLICE=y
CONFIG_NET_ACT_GACT=y
CONFIG_NET_ACT_MIRRED=y
CONFIG_VSOCKETS=y
CONFIG_BT=y
CONFIG_BT_BCM43XX=y
CONFIG_CFG80211=y
CONFIG_CFG80211_SAE_BKPORT=y
CONFIG_NL80211_TESTMODE=y
CONFIG_MAC80211=y
# CONFIG_MAC80211_RC_MINSTREL is not set
CONFIG_RFKILL=y
CONFIG_NFC_PN547=y
CONFIG_NFC_PN547_ESE_SUPPORT=y
CONFIG_ESE_SECURE=y
CONFIG_ESE_SECURE_SPI_PORT=7
CONFIG_ESE_SECURE_USI_MODE=12
CONFIG_SEC_NFC_LOGGER=n
# CONFIG_UEVENT_HELPER is not set
CONFIG_DEVTMPFS=y
CONFIG_FW_LOADER_USER_HELPER_FALLBACK=y
CONFIG_DMA_CMA=y
CONFIG_CMA_SIZE_MBYTES=26
CONFIG_ZRAM=y
CONFIG_BLK_DEV_LOOP=y
CONFIG_BLK_DEV_LOOP_MIN_COUNT=16
CONFIG_BLK_DEV_RAM=y
CONFIG_BLK_DEV_RAM_SIZE=8192
CONFIG_UID_SYS_STATS=y
CONFIG_MEMORY_STATE_TIME=y
CONFIG_MCU_IPC=y
CONFIG_SHM_IPC=y
CONFIG_SEC_SIPC_MODEM_IF=y
CONFIG_LINK_DEVICE_NAPI=y
CONFIG_HW_REV_DETECT=y
CONFIG_MODEM_IF_QOS=y
CONFIG_MODEM_IF_NET_GRO=y
CONFIG_USE_MUIC=y
CONFIG_USE_SAFEOUT=y
CONFIG_MUIC_NOTIFIER=y
CONFIG_MUIC_MANAGER=y
CONFIG_MUIC_CORE=y
CONFIG_MUIC_HV=y
CONFIG_MUIC_SUPPORT_CCIC=y
CONFIG_MUIC_SUPPORT_POWERMETER=y
CONFIG_MUIC_SYSFS=y
CONFIG_HV_MUIC_VOLTAGE_CTRL=y
CONFIG_MUIC_S2MU106=y
CONFIG_HV_MUIC_S2MU106_AFC=y
CONFIG_MUIC_S2MU106_RID=y
CONFIG_MUIC_S2MU107=y
CONFIG_HV_MUIC_S2MU107_AFC=y
CONFIG_MUIC_S2MU107_RID=y
CONFIG_MUIC_SUPPORT_PRSWAP=y
CONFIG_SCSI=y
CONFIG_UFS_SRPMB=y
CONFIG_BLK_DEV_SD=y
CONFIG_SCSI_UFSHCD=y
CONFIG_SCSI_UFSHCD_PLATFORM=y
CONFIG_SCSI_UFS_ASYNC_RELINK=y
CONFIG_SCSI_UFS_CMD_LOGGING=n
CONFIG_UFS_DATA_LOG=n
CONFIG_UFS_DATA_LOG_MAGIC_CODE=y
CONFIG_SCSI_UFS_EXYNOS=y
CONFIG_SCSI_UFS_EXYNOS_FMP=y
CONFIG_MD=y
CONFIG_BLK_DEV_DM=y
CONFIG_DM_CRYPT=y
CONFIG_DM_UEVENT=y
CONFIG_DM_VERITY=y
CONFIG_DM_VERITY_FEC=y
CONFIG_DM_ANDROID_VERITY_AT_MOST_ONCE_DEFAULT_ENABLED=y
CONFIG_DM_BOW=y
CONFIG_NETDEVICES=y
CONFIG_TUN=y
CONFIG_PPP=y
CONFIG_PPP_BSDCOMP=y
CONFIG_PPP_DEFLATE=y
CONFIG_PPP_FILTER=y
CONFIG_PPP_MPPE=y
CONFIG_PPP_MULTILINK=y
CONFIG_PPPOE=y
CONFIG_PPTP=y
CONFIG_PPPOL2TP=y
CONFIG_PPPOLAC=y
CONFIG_PPPOPNS=y
CONFIG_PPP_ASYNC=y
CONFIG_PPP_SYNC_TTY=y
CONFIG_USB_RTL8150=y
CONFIG_USB_RTL8152=y
CONFIG_USB_USBNET=y
CONFIG_USB_NET_CDC_EEM=y
CONFIG_USB_NET_CDC_MBIM=y
CONFIG_USB_NET_SMSC75XX=y
CONFIG_USB_NET_SMSC95XX=y
CONFIG_BCM4361=y
CONFIG_WLAN_TSQ_MULTIPLIER=y
CONFIG_WLAN_VENDOR_DUMP_ENABLE=y
CONFIG_WLAN_ANQP_RMAC_BACKPORTED=y
CONFIG_INPUT_EVDEV=y
CONFIG_INPUT_KEYRESET=y
CONFIG_HALL=y
CONFIG_CERTIFY_HALL=y
CONFIG_KEYBOARD_GPIO=y
# CONFIG_INPUT_MOUSE is not set
CONFIG_INPUT_JOYSTICK=y
CONFIG_JOYSTICK_XPAD=y
CONFIG_JOYSTICK_XPAD_FF=y
CONFIG_JOYSTICK_XPAD_LEDS=y
CONFIG_INPUT_TABLET=y
CONFIG_TABLET_USB_ACECAD=y
CONFIG_TABLET_USB_AIPTEK=y
CONFIG_TABLET_USB_GTCO=y
CONFIG_TABLET_USB_HANWANG=y
CONFIG_TABLET_USB_KBTAB=y
CONFIG_INPUT_TOUCHSCREEN=y
CONFIG_TOUCHSCREEN_MELFAS_MSS100=y
CONFIG_INPUT_WACOM=y
CONFIG_EPEN_WACOM_W9018=y
CONFIG_INPUT_MISC=y
CONFIG_INPUT_UINPUT=y
CONFIG_INPUT_GPIO=y
# CONFIG_SERIO_SERPORT is not set
# CONFIG_VT is not set
# CONFIG_LEGACY_PTYS is not set
# CONFIG_DEVMEM is not set
# CONFIG_DEVKMEM is not set
CONFIG_SERIAL_SAMSUNG=y
CONFIG_SERIAL_SAMSUNG_CONSOLE=y
# CONFIG_HW_RANDOM is not set
CONFIG_SRANDOM=y
CONFIG_I2C_CHARDEV=y
CONFIG_SPI=y
CONFIG_SENSORS_FP_SPI_NUMBER=1
CONFIG_SPI_S3C64XX=y
CONFIG_GPIOLIB=y
CONFIG_GPIO_SYSFS=y
CONFIG_SENSORS_SEC_THERMISTOR=y
CONFIG_THERMAL=y
CONFIG_THERMAL_WRITABLE_TRIPS=y
CONFIG_THERMAL_GOV_POWER_ALLOCATOR=y
CONFIG_CPU_THERMAL=y
CONFIG_GPU_THERMAL=y
CONFIG_ISP_THERMAL=y
CONFIG_THERMAL_EMULATION=y
CONFIG_EXYNOS_THERMAL=y
CONFIG_EXYNOS_ACPM_THERMAL=y
CONFIG_WATCHDOG=y
CONFIG_S3C2410_WATCHDOG=y
CONFIG_S3C2410_SHUTDOWN_REBOOT=y
CONFIG_MFD_S2MU107=y
CONFIG_MFD_S2MU106=y
CONFIG_MFD_SEC_CORE=y
CONFIG_MFD_S2MPS18=y
CONFIG_MFD_S2MPB02=y
CONFIG_REGULATOR_FIXED_VOLTAGE=y
CONFIG_REGULATOR_S2MPS18=y
CONFIG_REGULATOR_S2MPB02=y
CONFIG_REGULATOR_S2MPB03=y
CONFIG_REGULATOR_S2DOS05=y
CONFIG_MEDIA_SUPPORT=y
CONFIG_MEDIA_CAMERA_SUPPORT=y
CONFIG_MEDIA_RADIO_SUPPORT=y
CONFIG_V4L_PLATFORM_DRIVERS=y
CONFIG_VIDEO_EXYNOS_SCALER=y
CONFIG_VIDEO_EXYNOS_MFC=y
CONFIG_VIDEO_EXYNOS_SMFC=y
CONFIG_VIDEO_EXYNOS_FIMC_IS2=y
CONFIG_USE_CSI_DMAOUT_FEATURE=y
CONFIG_CAMERA_CIS_3M3_OBJ=y
CONFIG_CAMERA_CIS_3L6_OBJ=y
CONFIG_CAMERA_CIS_2L2_OBJ=y
CONFIG_CAMERA_CIS_IMX333_OBJ=y
CONFIG_CAMERA_CIS_IMX616_OBJ=y
CONFIG_CAMERA_ACT_AK737X_OBJ=y
CONFIG_CAMERA_FLASH_S2MU106_OBJ=y
CONFIG_CAMERA_FLASH_S2MU107_OBJ=y
CONFIG_USE_SENSOR_GROUP=y
CONFIG_VENDER_MCD=y
CONFIG_SECURE_CAMERA_USE=y
CONFIG_CAMERA_EEPROM_SUPPORT_FRONT=y
CONFIG_CAMERA_FROM=y
CONFIG_SENSOR_RETENTION_USE=y
CONFIG_OIS_USE=y
CONFIG_CAMERA_RNS_V07=y
CONFIG_OIS_USE_RUMBA_S6=y
CONFIG_VIDEO_EXYNOS_REPEATER=y
CONFIG_VIDEO_EXYNOS_TSMUX=y
CONFIG_RADIO_RTC6213N=y
CONFIG_I2C_RTC6213N=y
CONFIG_EXYNOS_SOC_NAME="9810"
# CONFIG_MALI_DEBUG_SYS is not set
# CONFIG_MALI_EXYNOS_DEBUG is not set
CONFIG_EXYNOS_HDR_TUNABLE_TONEMAPPING=y
CONFIG_EXYNOS_GRAPHICS_G2D=y
CONFIG_FB=y
CONFIG_FB_MODE_HELPERS=y
CONFIG_FB_SIMPLE=y
CONFIG_DECON_HIBER=y
CONFIG_SUPPORT_DOZE=y
CONFIG_EXYNOS_AFBC=y
CONFIG_DECON_BTS_LEGACY=y
CONFIG_DPU_2_0_FENCE=y
CONFIG_DPU_2_0_RELEASE_FENCES=y
CONFIG_EXYNOS_DECON_LCD=y
# CONFIG_EXYNOS_COMMON_PANEL is not set
CONFIG_EXYNOS_MASS_PANEL=y
CONFIG_DISPLAY_USE_INFO=y
CONFIG_EXYNOS_DECON_MDNIE=y
CONFIG_EXYNOS_DECON_LCD_S6E3FA9_ANOTE=y
CONFIG_SUPPORT_MASK_LAYER=y
CONFIG_SEC_DISPLAYPORT_LOGGER=y
CONFIG_SEC_DISPLAYPORT_BIGDATA=y
CONFIG_BACKLIGHT_LCD_SUPPORT=y
CONFIG_LCD_CLASS_DEVICE=y
CONFIG_BACKLIGHT_CLASS_DEVICE=y
# CONFIG_BACKLIGHT_GENERIC is not set
CONFIG_SOUND=y
CONFIG_SND=y
CONFIG_SND_DYNAMIC_MINORS=y
CONFIG_SND_USB_AUDIO=y
CONFIG_SND_SOC=y
CONFIG_SND_SOC_SAMSUNG=y
CONFIG_SND_SOC_SAMSUNG_EXYNOS9810=y
CONFIG_SND_SOC_SAMSUNG_R7_RT5665_TAS2562=y
CONFIG_SND_SOC_SAMSUNG_AUDIO=y
CONFIG_SEC_SND_ADAPTATION=y
CONFIG_SND_SOC_SAMSUNG_MAILBOX=y
CONFIG_SND_SOC_SAMSUNG_VTS=y
CONFIG_SND_SOC_TAS2562=y
CONFIG_TAS2562_REGMAP=y
CONFIG_TAS2562_CODEC=y
CONFIG_TAS25XX_ALGO=y
CONFIG_HIDRAW=y
CONFIG_UHID=y
CONFIG_HID_A4TECH=y
CONFIG_HID_ACRUX=y
CONFIG_HID_ACRUX_FF=y
CONFIG_HID_APPLE=y
CONFIG_HID_BELKIN=y
CONFIG_HID_CHERRY=y
CONFIG_HID_CHICONY=y
CONFIG_HID_PRODIKEYS=y
CONFIG_HID_CYPRESS=y
CONFIG_HID_DRAGONRISE=y
CONFIG_DRAGONRISE_FF=y
CONFIG_HID_EMS_FF=y
CONFIG_HID_ELECOM=y
CONFIG_HID_EZKEY=y
CONFIG_HID_KEYTOUCH=y
CONFIG_HID_KYE=y
CONFIG_HID_UCLOGIC=y
CONFIG_HID_WALTOP=y
CONFIG_HID_GYRATION=y
CONFIG_HID_TWINHAN=y
CONFIG_HID_KENSINGTON=y
CONFIG_HID_LCPOWER=y
CONFIG_HID_LOGITECH=y
CONFIG_HID_LOGITECH_DJ=y
CONFIG_LOGITECH_FF=y
CONFIG_LOGIRUMBLEPAD2_FF=y
CONFIG_LOGIG940_FF=y
CONFIG_HID_MAGICMOUSE=y
CONFIG_HID_MICROSOFT=y
CONFIG_HID_MONTEREY=y
CONFIG_HID_MULTITOUCH=y
CONFIG_HID_NINTENDO=y
CONFIG_HID_ORTEK=y
CONFIG_HID_PANTHERLORD=y
CONFIG_PANTHERLORD_FF=y
CONFIG_HID_PETALYNX=y
CONFIG_HID_PICOLCD=y
CONFIG_HID_PLANTRONICS=y
CONFIG_HID_PRIMAX=y
CONFIG_HID_ROCCAT=y
CONFIG_HID_SAITEK=y
CONFIG_HID_SAMSUNG=y
CONFIG_HID_SONY=y
CONFIG_SONY_FF=y
CONFIG_HID_SPEEDLINK=y
CONFIG_HID_SUNPLUS=y
CONFIG_HID_GREENASIA=y
CONFIG_GREENASIA_FF=y
CONFIG_HID_SMARTJOYPLUS=y
CONFIG_SMARTJOYPLUS_FF=y
CONFIG_HID_TIVO=y
CONFIG_HID_TOPSEED=y
CONFIG_HID_THRUSTMASTER=y
CONFIG_HID_WACOM=y
CONFIG_HID_WIIMOTE=y
CONFIG_HID_ZEROPLUS=y
CONFIG_HID_ZYDACRON=y
CONFIG_USB_HIDDEV=y
CONFIG_USB_ANNOUNCE_NEW_DEVICES=y
CONFIG_USB_XHCI_HCD=y
CONFIG_USB_HOST_L1_SUPPORT=y
CONFIG_USB_ACM=y
CONFIG_USB_PRINTER=y
CONFIG_USB_STORAGE=y
CONFIG_USB_HOST_NOTIFY=y
CONFIG_USB_NOTIFY_LAYER=y
CONFIG_USB_NOTIFIER=y
CONFIG_USB_DEBUG_DETAILED_LOG=y
CONFIG_USB_STORAGE_DETECT=y
CONFIG_USB_EXTERNAL_NOTIFY=y
CONFIG_USB_NOTIFY_PROC_LOG=y
CONFIG_USB_HOST_SAMSUNG_FEATURE=y
CONFIG_USB_HW_PARAM=y
CONFIG_USB_INTERFACE_LPM_LIST=y
CONFIG_USB_TYPEC_MANAGER_NOTIFIER=y
CONFIG_USB_DWC3=y
CONFIG_USB_ANDROID_SAMSUNG_DISABLE_U1_U2=y
CONFIG_USB_SERIAL=y
CONFIG_USB_SERIAL_FTDI_SIO=y
CONFIG_USB_SERIAL_PL2303=y
CONFIG_USB_GADGET=y
CONFIG_USB_G_ANDROID=y
CONFIG_USB_ANDROID_SAMSUNG_COMPOSITE=y
CONFIG_USB_DUN_SUPPORT=y
CONFIG_USB_NCM_SUPPORT_MTU_CHANGE=y
CONFIG_USB_CONFIGFS=y
CONFIG_USB_CONFIGFS_ACM=y
CONFIG_USB_CONFIGFS_NCM=y
CONFIG_USB_CONFIGFS_RNDIS=y
CONFIG_USB_CONFIGFS_F_FS=y
CONFIG_USB_CONFIGFS_F_DM=y
CONFIG_USB_CONFIGFS_F_MTP=y
CONFIG_USB_CONFIGFS_F_PTP=y
CONFIG_USB_CONFIGFS_F_CONN_GADGET=y
CONFIG_USB_F_CONN_GADGET_NDOP=y
CONFIG_USB_CONFIGFS_F_SS_MON_GADGET=y
CONFIG_USB_CONFIGFS_F_ACC=y
CONFIG_USB_CONFIGFS_F_AUDIO_SRC=y
CONFIG_USB_CONFIGFS_UEVENT=y
CONFIG_USB_RNDIS_MULTIPACKET=y
CONFIG_USB_CONFIGFS_F_MIDI=y
CONFIG_MMC=y
CONFIG_MMC_BLOCK_DEFERRED_RESUME=y
CONFIG_MMC_DW=y
CONFIG_MMC_DW_IDMAC=y
CONFIG_MMC_DW_64BIT_DESC=y
CONFIG_MMC_DW_EXYNOS=y
CONFIG_MMC_DW_DEBUG=y
CONFIG_MMC_DW_FORCE_32BIT_SFR_RW=y
CONFIG_LEDS_S2MU107_FLASH=y
CONFIG_LEDS_S2MU106_FLASH=y
CONFIG_SWITCH=y
CONFIG_SENSORS_FINGERPRINT=y
CONFIG_SENSORS_ET7XX=y
CONFIG_RTC_CLASS=y
CONFIG_RTC_DRV_S2MPS18=y
CONFIG_DMADEVICES=y
CONFIG_SYNC_FILE=y
CONFIG_SW_SYNC=y
CONFIG_STAGING=y
CONFIG_ASHMEM=y
CONFIG_ANDROID_LOW_MEMORY_KILLER=y
CONFIG_ANDROID_INTF_ALARM_DEV=y
# CONFIG_SAMSUNG_LMKD_DEBUG is not set
CONFIG_ION=y
CONFIG_ION_EXYNOS=y
CONFIG_ANDROID_SWITCH=y
CONFIG_SEC_STI=y
CONFIG_SEC_ABC=y
CONFIG_SEC_ABC_HUB=y
CONFIG_SEC_ABC_HUB_COND=y
CONFIG_SEC_ABC_HUB_BOOTC=y
CONFIG_EXYNOS_IOMMU=y
CONFIG_EXYNOS_CHIPID=y
CONFIG_EXYNOS_PMU=y
CONFIG_ECT=y
CONFIG_ECT_DUMP=y
CONFIG_EXYNOS_PD=y
CONFIG_CAL_IF=y
CONFIG_EXYNOS_REBOOT=y
CONFIG_EXYNOS_PM_DVS=y
CONFIG_FLEXPMU=y
CONFIG_CP_PMUCAL=y
CONFIG_CMUCAL_DEBUG=y
CONFIG_CMUCAL_QCH_IGNORE_SUPPORT=y
CONFIG_EXYNOS_ACPM=y
CONFIG_EXYNOS_ACPM_S2D=y
CONFIG_USI_V2=y
CONFIG_EXYNOS_HOTPLUG_GOVERNOR=y
CONFIG_EXYNOS_DVFS_MANAGER=y
CONFIG_EXYNOS_MCINFO=y
CONFIG_EXYNOS_KERNEL_PROTECTION=y
CONFIG_ARM_EXYNOS_DEVFREQ=y
CONFIG_EXTCON=y
CONFIG_IIO=y
CONFIG_IIO_BUFFER=y
CONFIG_IIO_KFIFO_BUF=y
CONFIG_IIO_TRIGGER=y
CONFIG_EXYNOS_ADC=y
CONFIG_PWM=y
CONFIG_PWM_SAMSUNG=y
CONFIG_BATTERY_SAMSUNG=y
CONFIG_BATTERY_SAMSUNG_V2=y
CONFIG_CHARGER_PCA9468=y
CONFIG_CHARGER_S2MU107=y
CONFIG_CHARGER_S2MU107_DIRECT=y
CONFIG_PM_S2MU107=y
CONFIG_CALC_TIME_TO_FULL=y
CONFIG_STEP_CHARGING=y
CONFIG_ENABLE_FULL_BY_SOC=y
CONFIG_DIRECT_CHARGING=y
CONFIG_BATTERY_CISD=y
CONFIG_AFC_CHARGER_MODE=y
CONFIG_BATTERY_AGE_FORECAST=y
CONFIG_BATTERY_NOTIFIER=y
CONFIG_ENABLE_100MA_CHARGING_BEFORE_USB_CONFIGURED=y
CONFIG_FUELGAUGE_S2MU107=y
CONFIG_FUELGAUGE_S2MU107_TEMP_COMPEN=y
CONFIG_FUELGAUGE_S2MU107_BATCAP_LRN=y
CONFIG_BATTERY_SWELLING=y
CONFIG_LSI_IFPMIC=y
CONFIG_FUELGAUGE_S2MU106=y
CONFIG_FUELGAUGE_S2MU106_USE_5MILLIOHM=y
CONFIG_CHARGER_S2MU106=y
CONFIG_PM_S2MU106=y
# CONFIG_PHY_EXYNOS_MIPI_VIDEO is not set
CONFIG_PHY_EXYNOS9810_MIPI=y
CONFIG_PHY_EXYNOS_DISPLAYPORT=y
# CONFIG_PHY_EXYNOS_DP_VIDEO is not set
CONFIG_ANDROID=y
CONFIG_ANDROID_BINDER_IPC=y
# CONFIG_EXYNOS_CONSOLE_DEBUGGER is not set
CONFIG_VISION_SUPPORT=y
CONFIG_EXYNOS_IVA=y
CONFIG_EXYNOS_SCORE=y
CONFIG_EXYNOS_SCORE_V2=y
CONFIG_USE_CCIC=y
CONFIG_CCIC_NOTIFIER=y
CONFIG_CCIC_S2MU107=y
CONFIG_CCIC_S2MU106=y
CONFIG_PDIC_PD30=y
CONFIG_TRUSTONIC_TRUSTED_UI=y
CONFIG_TRUSTONIC_TRUSTED_UI_FB_BLANK=y
CONFIG_TRUSTED_UI_TOUCH_ENABLE=y
CONFIG_CM_OFFSET=7340596
CONFIG_WC_OFFSET=7340612
CONFIG_SAMSUNG_PRODUCT_SHIP=y
CONFIG_ARGOS=y
CONFIG_SEC_SYSUP=y
CONFIG_SEC_DEBUG_SOFTDOG_PWDT=y
CONFIG_SEC_NAD=y
CONFIG_SEC_SUPPORT_SECOND_NAD=y
CONFIG_SEC_SUPPORT_VST=y
CONFIG_VBUS_NOTIFIER=y
CONFIG_SEC_VIBRATOR=y
CONFIG_ISA1000_VIBRATOR=y
CONFIG_GPS_BCMxxxxx=y
CONFIG_GPS_BCM4773=y
CONFIG_SENSORS_SYSFS=y
CONFIG_SENSORS_SSP=y
CONFIG_SENSORS_SSP_BBD=y
CONFIG_SENSORS_SSP_LSM6DSL=y
CONFIG_SENSORS_SSP_MAGNETIC_COMMON=y
CONFIG_SENSORS_SSP_LPS22H=y
CONFIG_SENSORS_SSP_SENSORHUB=y
CONFIG_SENSORS_SSP_MOBEAM=y
CONFIG_SENSORS_SSP_TMD4906=y
CONFIG_SENSORS_SSP_PROX_AUTOCAL_AMS=y
CONFIG_SENSORS_SSP_LIGHT_REPORT_LUX=y
CONFIG_SENSORS_SSP_LIGHT_COLORID=y
CONFIG_SENSORS_SSP_IRDATA_FOR_CAMERA=y
CONFIG_SENSORS_MULTIPLE_GLASS_TYPE=y
CONFIG_SENSORS_SSP_INTERRUPT_GYRO_SENSOR=y
CONFIG_SENSORS_SSP_HIFI_BATCHING=y
CONFIG_SSP_MOTOR_CALLBACK=y
CONFIG_SENSORS_SSP_THERMISTOR=y
CONFIG_SSP_SUPPORT_MAGNETIC_OVERFLOW=y
CONFIG_SENSORS_FW_VENDOR=y
CONFIG_SENSORS_A96T3X6_CRC_CHECK=y
CONFIG_SENSORS_A96T365IF=y
CONFIG_SENSORS_SSP_VCNL36811S=y
CONFIG_SENSORS_SABC=y
CONFIG_SPU_VERIFY=y
CONFIG_EXT2_FS=y
CONFIG_EXT2_FS_XATTR=y
CONFIG_EXT2_FS_SECURITY=y
CONFIG_EXT3_FS=y
CONFIG_EXT3_FS_SECURITY=y
CONFIG_EXT4_ENCRYPTION=y
CONFIG_F2FS_FS=y
CONFIG_F2FS_FS_SECURITY=y
CONFIG_F2FS_FS_ENCRYPTION=y
CONFIG_QUOTA=y
CONFIG_QUOTA_NETLINK_INTERFACE=y
CONFIG_QFMT_V2=y
CONFIG_FUSE_FS=y
CONFIG_OVERLAY_FS=y
CONFIG_MSDOS_FS=y
CONFIG_VFAT_FS=y
CONFIG_NTFS_FS=y
CONFIG_NTFS_DEBUG=y
CONFIG_PROC_AVC=y
CONFIG_TMPFS=y
CONFIG_TMPFS_POSIX_ACL=y
CONFIG_ECRYPT_FS=y
CONFIG_WTL_ENCRYPTION_FILTER=y
CONFIG_ECRYPTFS_FEK_INTEGRITY=y
CONFIG_SDP=y
CONFIG_CRAMFS=y
CONFIG_PSTORE=y
CONFIG_PSTORE_CONSOLE=y
CONFIG_PSTORE_PMSG=y
CONFIG_PSTORE_RAM=y
CONFIG_PRINTK_TIME=y
CONFIG_PRINTK_PROCESS=y
CONFIG_DEBUG_INFO=y
CONFIG_FRAME_WARN=4096
CONFIG_MAGIC_SYSRQ=y
CONFIG_LOCKUP_DETECTOR=y
CONFIG_BOOTPARAM_HARDLOCKUP_PANIC=y
CONFIG_BOOTPARAM_SOFTLOCKUP_PANIC=y
CONFIG_PANIC_TIMEOUT=5
# CONFIG_SCHED_DEBUG is not set
CONFIG_SCHEDSTATS=y
CONFIG_TIMER_STATS=y
# CONFIG_DEBUG_PREEMPT is not set
CONFIG_DEBUG_ATOMIC_SLEEP=y
CONFIG_DEBUG_LIST=y
CONFIG_ENABLE_DEFAULT_TRACERS=y
CONFIG_ATOMIC64_SELFTEST=y
CONFIG_SECURITY_PERF_EVENTS_RESTRICT=y
CONFIG_SECURITY=y
CONFIG_SECURITY_NETWORK=y
CONFIG_LSM_MMAP_MIN_ADDR=4096
CONFIG_HARDENED_USERCOPY=y
CONFIG_SECURITY_SELINUX=y
CONFIG_INTEGRITY_SIGNATURE=y
CONFIG_INTEGRITY_ASYMMETRIC_KEYS=y
CONFIG_CRYPTO_TEST=y
CONFIG_CRYPTO_SHA512=y
CONFIG_CRYPTO_TWOFISH=y
CONFIG_CRYPTO_DISKCIPHER=y
CONFIG_CRYPTO_POST_LATE_INIT_SYNC=y
CONFIG_EXYNOS_FMP=y
CONFIG_ARM64_CRYPTO=y
CONFIG_CRYPTO_SHA1_ARM64_CE=y
CONFIG_CRYPTO_SHA2_ARM64_CE=y
CONFIG_CRYPTO_AES_ARM64_CE_BLK=y
CONFIG_SCHED_DEBUG=y
```
